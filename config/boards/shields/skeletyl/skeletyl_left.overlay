#include "skeletyl.dtsi"

// # on board (# my config)
// C1 - x (20)
// C2 (C0) - 21
// C3 (C1) - 10
// C4 (C2) - 6
// C5 (C3) - 7
// C6 (C4) - 8
&kscan0 {
	col-gpios
		= <&pro_micro_d 21 (GPIO_ACTIVE_HIGH | GPIO_PULL_DOWN)>
		, <&pro_micro_d 10 (GPIO_ACTIVE_HIGH | GPIO_PULL_DOWN)>
		, <&pro_micro_d  6 (GPIO_ACTIVE_HIGH | GPIO_PULL_DOWN)>
		, <&pro_micro_d  7 (GPIO_ACTIVE_HIGH | GPIO_PULL_DOWN)>
		, <&pro_micro_d  8 (GPIO_ACTIVE_HIGH | GPIO_PULL_DOWN)>
		;
};

// / {
//     leds {
//         compatible = "worldsemi,ws2812-spi";
//         label = "RGB";
//         chain-length = <18>;            // Number of LEDs
//         spi-max-frequency = <2400000>;  // Frequency for SPI communication
//         gpio-pin = <&gpio0 1 GPIO_ACTIVE_HIGH>; // Adjust to match your PCB design
//     };
// };