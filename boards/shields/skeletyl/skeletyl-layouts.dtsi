#include <physical_layouts.dtsi>

/ {
    skeletyl_layout: skeletyl_layout {
        compatible = "zmk,physical-layout";
        display-name = "Skeletyl 3x5 Layout";
        transform = <&default_transform>;
        kscan = <&kscan0>;
    };
};